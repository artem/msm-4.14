/*
 * Copyright (C) 2017 Sony Mobile Communications Inc.
 *
 * This program is free software; you can redistribute it and/or modify
 * it under the terms of the GNU General Public License version 2, as
 * published by the Free Software Foundation.
 */
/dts-v1/;
/plugin/;

/ {

	fragment@0 {
		target = <&electric_1>;

		__overlay__ {

			// This label should cause an error when the overlay
			// is applied.  There is already a symbol hvac_1
			// in the base tree
			hvac_1: hvac-medium-2 {
				compatible = "ot,hvac-medium";
				heat-range = < 50 75 >;
				cool-range = < 60 80 >;
			};

		};
	};
};
